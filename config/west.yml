## config/west.yml
```yaml
manifest: 
  remotes:
    - name: zmkfirmware
      url-base: https://github.com/zmkfirmware
    - name: badjeff
      url-base: https://github.com/badjeff
    - name: hsgw
      url-base: https://github.com/hsgw
    - name: caksoylar  # <-- led
      url-base: https://github.com/caksoylar
    - name: Dist16384  # <-- PMW3610 driver fork
      url-base: https://github.com/Dist16384

  projects:
    # ZMK 本体。公式の app/west.yml を取り込む
    - name: zmk
      remote: zmkfirmware
      revision: v0.3
      import: app/west.yml

    # PMW3610 ドライバ（外部モジュール）
    # badjeff/zmk-pmw3610-driver ではなく、
    # Dist16384/zmk-pmw3610-driver を使う
    - name: zmk-pmw3610-driver
      remote: Dist16384
      revision: main
      path: modules/zmk-pmw3610-driver
    
    # Sensor-rotation
    - name: zmk-feature-sensor_rotation
      remote: hsgw
      revision: main

    # LED
    - name: zmk-rgbled-widget  # <-- led
      remote: caksoylar
      revision: v0.3
      
  self:
    path: config
```
